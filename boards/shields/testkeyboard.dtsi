/ {
    keymap {
        compatible = "zmk,keymap";

        default_layer {
            bindings = <
                &kp A
            >;
        };
    };
};


&kscan {
    col-gpios = <&gpio0 11 (GPIO_ACTIVE_LOW)>;
    row-gpios = <&gpio0 10 (GPIO_ACTIVE_HIGH)>;
    diode-direction = <ROW2COL>;
};
